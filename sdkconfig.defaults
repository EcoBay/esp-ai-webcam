## sdkconfig.defaults
```kconfig
# Remove support for other camera
CONFIG_OV7670_SUPPORT=n
CONFIG_OV7725_SUPPORT=n
CONFIG_NT99141_SUPPORT=n
CONFIG_OV2640_SUPPORT=y
CONFIG_OV3660_SUPPORT=n
CONFIG_OV5640_SUPPORT=n
CONFIG_GC2145_SUPPORT=n
CONFIG_GC032A_SUPPORT=n
CONFIG_GC0308_SUPPORT=n
CONFIG_BF3005_SUPPORT=n
CONFIG_CAMERA_CORE1=y

# Enable spiram for esp32 camera
CONFIG_ESP32_SPIRAM_SUPPORT=y

# Set networking to run on CORE0
CONFIG_ASYNC_TCP_RUN_CORE0=y
CONFIG_ARDUINO_RUN_CORE0=y
CONFIG_ARDUINO_RUNNING_CORE=0
CONFIG_ARDUINO_EVENT_RUNNING_CORE=0
CONFIG_ARDUINO_UDP_RUN_CORE0=y
CONFIG_ARDUINO_UDP_RUNNING_CORE=0
```
